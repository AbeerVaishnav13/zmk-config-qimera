## config/boards/shields/qimera/Kconfig.defconfig
```kconfig
if SHIELD_QIMERA_LEFT

config ZMK_KEYBOARD_NAME
    default "Qimera v1"

config ZMK_SPLIT_ROLE_CENTRAL
    default y

endif

if SHIELD_QIMERA_LEFT || SHIELD_QIMERA_RIGHT

config ZMK_SPLIT
    default y

endif
```

## config/boards/shields/qimera/Kconfig.shield
```kconfig
config SHIELD_QIMERA_LEFT
    def_bool $(shields_list_contains,qimera_left)

config SHIELD_QIMERA_RIGHT
    def_bool $(shields_list_contains,qimera_right)
```
